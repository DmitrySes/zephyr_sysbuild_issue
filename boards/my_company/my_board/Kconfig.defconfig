## boards/my_company/my_board/Kconfig.defconfig
```kconfig
if BOARD_MY_BOARD_CPUAPP

config BT_CTLR
	default BT

config ROM_START_OFFSET
	default 0x800 if BOOTLOADER_MCUBOOT

endif # BOARD_MY_BOARD_CPUAPP
```

## boards/my_company/my_board/Kconfig.my_board
```kconfig
config BOARD_MY_BOARD
	select SOC_NRF54L15_CPUAPP if BOARD_MY_BOARD_NRF54L15_CPUAPP
	select SOC_NRF54L15_CPUFLPR if \
		BOARD_MY_BOARD_NRF54L15_CPUFLPR || \
		BOARD_MY_BOARD_NRF54L15_CPUFLPR_XIP
```

## boards/my_company/my_board/board.yml
```yaml
board:
  name: my_board
  vendor: my_company
  socs:
  - name: nrf54l15
    variants:
    - name: xip
      cpucluster: cpuflpr
```
